## ptxproj/scripts/wago/bsp-scripts/tests/resources/sample_workspace_full_mock/bsp/ptxproj.2013.03.0/Kconfig
```kconfig
source "generated/foo"
source "generated/bar"
source "generated/baz"
source "generated/foobar"
```
